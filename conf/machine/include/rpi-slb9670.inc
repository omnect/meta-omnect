## conf/machine/include/rpi-slb9670.inc
```bitbake
ENABLE_SPI_BUS = "1"

RPI_EXTRA_CONFIG = "\n#Enable LetsTrust TPM module\n\
dtoverlay=tpm-slb9670\n"
```

## conf/machine/include/rpi.inc
```bitbake
require rpi_firmware_settings.inc
require rpi_bootloader_embedded_version.inc

PREFERRED_PROVIDER_virtual/bootloader = "u-boot"
# since u-boot is a file for rpi devices and part of IMAGE_BOOT_FILES, it is not in rootfs
# and not referenced in the wks file
# -> so it doesn't get added to dependency-track sbom
# we add an extra image dependency in this case
DEPENDS:pn-omnect-os-image:append = " virtual/bootloader"

# mask u_boot bbappend from meta-raspberrypi, we handle fw_env.conf in swupdates libubootenv
BBMASK += "/meta-raspberrypi/recipes-bsp/u-boot/u-boot_%.bbappend"

# u-boot to be able to switch between A/B updates
RPI_USE_U_BOOT = "1"

# initramfs type
OMNECT_INITRAMFS_FSTYPE = "cpio.gz.u-boot"

# configure hardware watchdog
# the maximum watchdog deadline depends on the hardware capabilities
SYSTEMD_RuntimeWatchdogSec  = "15"
SYSTEMD_RebootWatchdogSec   = "15"

# rpi bluetooth needs hciattach, which is marked deprecated
PACKAGECONFIG:pn-bluez5:append = " deprecated tools"

# this machine uses uboot and pstore feature
MACHINEOVERRIDES:prepend = "omnect_uboot:omnect_pstore:"

# reboot reason support via pstore/ramoops
MACHINE_FEATURES += "pstore"

# optional tpm2 support
MACHINE_FEATURES += "tpm2"

OMNECT_BOOTLOADER_RECIPE_PATH = "${LAYERDIR_core}/recipes-bsp/u-boot/u-boot_2024.01.bb"
# force bootloader version checksum to be old, when sure it's 100% binary compatible
# OMNECT_BOOTLOADER_CHECKSUM_COMPATIBLE:pn-bootloader-versioned = "<newchecksum> <oldchecksum>"
# e.g.:
# OMNECT_BOOTLOADER_CHECKSUM_COMPATIBLE:pn-bootloader-versioned = "2cf3dd5f692d9ed563f06ecf80d0cb566ddc165fa01a37b4eba663dc7b7b9087 ebe0e595a3efb112b7495a14f9562d89d00041390f26a9ad4985435687bf2310"
#
# OMNECT_BOOTLOADER_CHECKSUM_EXPTECTED:pn-bootloader-versioned - build will fail, if the
# computed checksum is different to this; set to <oldchecksum> when
# OMNECT_BOOTLOADER_CHECKSUM_COMPATIBLE:pn-bootloader-versioned is set
OMNECT_BOOTLOADER_CHECKSUM_EXPECTED:pn-bootloader-versioned = "f9beee6e5ca031cf7cc37403ddd116c9737c172cdd554e5faced296e2d5375e5"
OMNECT_BOOTLOADER_CHECKSUM_COMPATIBLE:pn-bootloader-versioned = "5df30fc7511f3bebec58662c4a1ca105c576d5d65245f0a10ab9284f391f56c0 f9beee6e5ca031cf7cc37403ddd116c9737c172cdd554e5faced296e2d5375e5"
```

## conf/machine/include/rpi_bootloader_embedded_version.inc
```bitbake
# definitions to embed bootloader version in binary
OMNECT_BOOTLOADER_EMBEDDED_VERSION_BBTARGET  = "virtual/bootloader"
OMNECT_BOOTLOADER_EMBEDDED_VERSION_BBFILE    = "u-boot.bin"
OMNECT_BOOTLOADER_EMBEDDED_VERSION_TYPE      = "file"
OMNECT_BOOTLOADER_EMBEDDED_VERSION_PARAMSIZE ?= "256"
OMNECT_BOOTLOADER_EMBEDDED_VERSION_LOCATION  = "/boot/kernel8.img"

IMAGE_BOOT_FILES:remove:omnect_uboot = "u-boot.bin;kernel8.img"
IMAGE_BOOT_FILES:append:omnect_uboot = " bootloader.versioned.bin;kernel8.img"
```

## conf/machine/include/rpi_firmware_settings.inc
```bitbake
# enable serial interface
ENABLE_UART = "1"

# build cmdline.txt
# overwrite CMDLINE_ROOTFS from meta-raspberrypi, we set "root" in boot.scr
CMDLINE_ROOTFS = ""
DISABLE_RPI_BOOT_LOGO = "1"
# prepend before uart console to prioritize serial console output of stdout
CMDLINE:prepend:pn-rpi-cmdline = "console=tty0 "
# prevent state where watchdog is disabled
CMDLINE:append:pn-rpi-cmdline = " bcm2835-wdt.nowayout=1"

# u-boot config vars
UBOOT_FDT_ADDR = "fdt_addr"

# redundant u-boot env
OMNECT_PART_OFFSET_UBOOT_ENV1 = "1024"
OMNECT_PART_OFFSET_UBOOT_ENV2 = "1152"
OMNECT_PART_SIZE_UBOOT_ENV = "64"

# for flash-mode and wic image
OMNECT_PART_OFFSET_BOOT = "2048"
```

## conf/machine/include/tpm-slb9670.inc
```bitbake
KERNEL_DEVICETREE:append:rpi = " overlays/tpm-slb9670.dtbo"
KERNEL_MODULE_AUTOLOAD += "tpm_tis_spi"
```

## conf/machine/odroid-c2.extra.conf
```bitbake
# hide bug in meta-odroid, we overwrite fw_env.config anyway
BBMASK += "/meta-odroid/recipes-bsp/u-boot/libubootenv_%.bbappend"

# wic: how to partition
WKS_FILE = "sdcard.wks.in"

# resize data partition
DISTRO_FEATURES_DEFAULT_append = " resize-data"

# for referencing the root device in fstab, uboot, and swupdate sw-description
# TODO get rid of that ... it is a problem when you use emmc instead of sdcard
ROOT_DEV = "/dev/mmcblk1"
ROOT_DEV_P = "/dev/mmcblk1p"

# u-boot config vars
KERNEL_BOOTCMD = "booti"
UBOOT_ARCH = "arm64"
#UBOOT_BOOTARGS_APPEND = "${UBOOT_VIDEO}"
UBOOT_FDT_ADDR = "fdt_addr_r"
UBOOT_FDT_LOAD = "1"
```

## conf/machine/phyboard-polis-imx8mm-4.extra.conf
```bitbake
require conf/machine/include/phytec-imx8mm.inc

# adu compatibility id
OMNECT_ADU_DEVICEPROPERTIES_COMPATIBILITY_ID = "0"

# since we do install a lot of dev packages in OMNECT_DEVEL_TOOLS
# and do not fit in IMAGE_ROOTFS_MAXSIZE, we have to tune the overhead factor
# of the readonly rootfs.
# - applies to kirkstone but not e.g. dunfell
# - alternative would be to change IMAGE_ROOTFS_MAXSIZE
IMAGE_OVERHEAD_FACTOR = "1.1"

# rm dtbos from boot partition (we install them in root)
IMAGE_BOOT_FILES:remove:pn-omnect-os-image = " \
    imx8mm-phyboard-polis-1532.1.dtbo \
    imx8mm-phyboard-polis-peb-eval-01.dtbo \
    imx8mm-phyboard-polis-peb-av-010.dtbo \
    imx8mm-phycore-rpmsg.dtbo \
    imx8mm-phycore-no-eth.dtbo \
    imx8mm-phycore-no-spiflash.dtbo \
    imx8mm-vm016.dtbo \
    imx8mm-vm016-fpdlink.dtbo \
    imx8mm-vm017.dtbo \
    imx8mm-vm017-fpdlink.dtbo \
    imx8mm-dual-vm017-fpdlink.dtbo \
"

# u-boot boot.scr config
KERNEL_DEVICETREE_FN = "imx8mm-phyboard-polis-rdk.dtb"

# TODO enable choosing between lwb firmware: etsi, fcc, jp
# enable wifi + bt
MACHINE_FIRMWARE:append = "lwb-etsi-firmware"

# wlan device name
OMNECT_WLAN0 = "wlan0"

OMNECT_WAIT_ONLINE_INTERFACES_BUILD = "eth0:${OMNECT_WLAN0}"

# no differentiation for now between release an devel images concerning rootfs
# size
OMNECT_PART_SIZE_ROOTFS ?= "${@bb.utils.contains('OMNECT_RELEASE_IMAGE', '1', '760832', '760832', d)}"

# meta-phytec compability fixes for scarthgap: TODO monitor when to get rid of them
COMPATIBLE_MACHINE:pn-linux-phytec = "phyboard-polis-imx8mm-4"
COMPATIBLE_MACHINE:pn-u-boot-phytec = "phyboard-polis-imx8mm-4"
```

## conf/machine/raspberrypi3.extra.conf
```bitbake
require conf/machine/include/rpi.inc

# adu combability id
ADU_DEVICEPROPERTIES_COMPATIBILITY_ID = "0"

# wic: how to partition
WKS_FILE = "omnect-os.rpi3.wks.in"

# u-boot boot cmd config vars
UBOOT_ARCH="arm"
```

## conf/machine/raspberrypi4-64.tpm.conf
```bitbake
require conf/machine/include/rpi-slb9670.inc
require conf/machine/include/tpm-slb9670.inc
```

## conf/machine/rpi4-omnect-lab.conf
```bitbake
# this is an artificial omnect product for testing purposes of features like
# LTE or TPM which is basically a plain Raspberrypi 4 with a USB LTE modem and
# a TPM module

require conf/machine/raspberrypi4-64.conf
require conf/machine/raspberrypi4-64.tpm.conf

require conf/machine/include/rpi.inc

DISTRO_FEATURES:append = " 3g tpm2"
MACHINE_FEATURES:append = " 3g tpm2"

# adu compatibility id
ADU_DEVICEPROPERTIES_COMPATIBILITY_ID = "0"

# wic: how to partition
WKS_FILE = "omnect-os.rpi4.wks.in"

# u-boot boot cmd config vars
UBOOT_ARCH = "arm64"

# no differentiation between release an devel images concerning rootfs size
OMNECT_PART_SIZE_ROOTFS    ?= "${@bb.utils.contains('OMNECT_RELEASE_IMAGE', '1', '900000', '900000', d)}"

# LTE modem is expected on lower USB3 port, and supported LTE modems are ...
# - Sierra Wireless Airprime EM7455 (wwan interface wwp1s0u1u2i8), or
# - Quectel EC25-EUX (wwan interface wwp1s0u1u2i8)
OMNECT_ONLINE_INTERFACES = "eth0:${OMNECT_WLAN0}:wwp1s0u1u2i8:wwp1s0u1u2i4"
```

## conf/machine/rpi4-test.conf
```bitbake
require conf/machine/raspberrypi4-64.conf
require conf/machine/raspberrypi4-64.tpm.conf
```

## conf/machine/rpi4-test.extra.conf
```bitbake
require conf/machine/include/rpi.inc

# FIXME: just for testing purposes, remove before merging!
DISTRO_FEATURES:append = " 3g tpm2"
MACHINE_FEATURES:append = " 3g"

# adu compatibility id
ADU_DEVICEPROPERTIES_COMPATIBILITY_ID = "2"

# wic: how to partition
WKS_FILE = "omnect-os.rpi4.wks.in"

# u-boot boot cmd config vars
UBOOT_ARCH = "arm64"

OMNECT_PART_SIZE_ROOTFS    ?= "900000"

OMNECT_ONLINE_INTERFACES = "${OMNECT_ETH0}"

# FIXME: just for testing purposes, remove before merging!
OMNECT_WWAN0 = "wwan0"
```
