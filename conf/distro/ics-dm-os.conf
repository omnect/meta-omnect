## conf/distro/ics-dm-os.conf
```bitbake
include conf/machine/${MACHINE}.extra.conf
require conf/distro/poky.conf
require conf/distro/include/ics-dm-os-distro.conf
require conf/distro/include/ics-dm-os-preferred.conf
require conf/distro/include/ics-dm-os-user_classes.conf
require conf/distro/include/ics-dm-os-swupdate.conf
```

## conf/distro/include/ics-dm-os-distro.conf
```bitbake
DISTRO = "ics-dm-os"
DISTRO_NAME = "${DISTRO_NAME_PREFIX}ICS-DM-OS${DISTRO_NAME_SUFFIX}"
DISTROOVERRIDES = "poky:ics-dm-os"
# DISTRO_VERSION is POKY_VERSION (since we include poky conf before our own
# distro settings) appended with a build number.
DISTRO_VERSION:append = ".${ICS_DM_BUILD_NUMBER}"
TARGET_VENDOR = "-icsdm"
# resize data partition
DISTRO_FEATURES_DEFAULT:append = " resize-data"

# Systemd
INIT_MANAGER ?= "systemd"
# disable sysusers
# Uids/gids created by systemd-sysusers could potentially clash with
# uids/gids introduced by later update images.
PACKAGECONFIG:remove:pn-systemd = "sysusers"

JOURNALD_SystemMaxUse ?= "128M"

# Use opkg's ipk
PACKAGE_CLASSES ?= "package_ipk"

# Check if Buildsystem can reach remote sources
CONNECTIVITY_CHECK_URIS ?= "https://github.com/ICS-DeviceManagement "

# Image configuration
IMAGE_FSTYPES = "ext4.gz wic.xz wic.bmap"
# rm kernel from boot partition, we use a bundled initramfs kernel in rootfs
IMAGE_BOOT_FILES:remove = "uImage Image"
# instead of kernel we want the initramfs bundled kernel
IMAGE_INSTALL:remove = "kernel"

# Disable busybox syslog
SRC_URI:remove:pn-busybox = "file://syslog.cfg"

# define partition (default) sizes in KiB
#     Note, the last data partition will be expanded during the first boot after image flashing inside the INITRAMFS.
#     This means, ICS_DM_PART_SIZE_DATA is the initial value.
#     Note, when using kas/feature/ics-dm-os-common.yaml the values configured there will override values here.
ICS_DM_PART_SIZE_BOOT ?= "40960"
ICS_DM_PART_SIZE_UBOOT_ENV ?= "64"
ICS_DM_PART_SIZE_ROOTFS ?= "760832"
ICS_DM_PART_SIZE_FACTORY ?= "40960"
ICS_DM_PART_SIZE_CERT ?= "40960"
ICS_DM_PART_SIZE_ETC ?= "40960"
ICS_DM_PART_SIZE_DATA ?= "524288"

# enable variable expansion in wks includes
WICVARS:append = " ICS_DM_PART_SIZE_BOOT"
WICVARS:append = " ICS_DM_PART_SIZE_UBOOT_ENV"
WICVARS:append = " ICS_DM_PART_SIZE_ROOTFS"
WICVARS:append = " ICS_DM_PART_SIZE_FACTORY"
WICVARS:append = " ICS_DM_PART_SIZE_CERT"
WICVARS:append = " ICS_DM_PART_SIZE_ETC"
WICVARS:append = " ICS_DM_PART_SIZE_DATA"

# location of u-boot environment areas in KiB
#   - Fixed addresses are used (--offset in WKS file), suitable for u-boot configuration.
#   - It has to be aligned with the boot partition (ICS_DM_PART_SIZE_BOOT) and the MBR/GPT.
#   - Wic aborts the build, in the case the partitions cannot be located at the fixed location.
#   - The partitions will be initialized with 0xff (--source in WKS file). In this way, u-boot is able
#     to create the default environment during the first boot after flashing the SD-Card image.
#   - No entries inside the partition table will be created (--no-table in WKS file).
#   - The variable ICS_DM_PART_SPARE1 is used to define a gap behind the boot partition.
#   - The variable ICS_DM_PART_SPARE2 is used to define a gap between both environment partitions.
#     In this way, the environment partitions can be located in different erase blocks.
ICS_DM_PART_SPARE1 = "8192"
ICS_DM_PART_SPARE2 = "1984"
ICS_DM_PART_OFFSET_UBOOT_ENV1 ?= "${@int(d.getVar('ICS_DM_PART_SIZE_BOOT')) + \
                                    int(d.getVar('ICS_DM_PART_SPARE1'))}"
ICS_DM_PART_OFFSET_UBOOT_ENV2 ?= "${@int(d.getVar('ICS_DM_PART_OFFSET_UBOOT_ENV1')) + \
                                    int(d.getVar('ICS_DM_PART_SIZE_UBOOT_ENV')) + \
                                    int(d.getVar('ICS_DM_PART_SPARE2'))}"

# limit max rootfs size
IMAGE_ROOTFS_MAXSIZE = "${ICS_DM_PART_SIZE_ROOTFS}"

# initramfs
ICS_DM_INITRAMFS_FSTYPE = "cpio.gz.u-boot"
ICS_DM_INITRAMFS_IMAGE_NAME = "${DISTRO_NAME}_${DISTRO_VERSION}_${MACHINE}-initramfs"

# enable curl-native with nghttp2 support for cargo-native(rust)
#
# todo: remove that if iot-identity-service is
#       not using cargo directly to download "vendor" dependencies anymore,
#       e.g. when we switch back to use meta-iotedge instead of own recipes
PACKAGECONFIG:append:pn-curl-native = " nghttp2"
# unfortunately the above line introduces a circular dependency error.
# we fix it by disabling cmake-native's download feature.
DEPENDS:remove:pn-cmake-native = "curl-native"
CMAKE_EXTRACONF:append:pn-cmake-native = " -DCMAKE_USE_SYSTEM_LIBRARY_CURL=0 -DCMAKE_USE_OPENSSL=OFF"

# lower alternative default priority
ALTERNATIVE_PRIORITY_coreutils = "30"
ALTERNATIVE_PRIORITY_procps = "40"

# explicitly control utilities used
ALTERNATIVE_PRIORITY_coreutils[dd] = "100"
ALTERNATIVE_PRIORITY_procps[ps] = "100"

# update-ca-certificates is not working when we include the following patch
# which poky applies
SRC_URI:remove:pn-ca-certificates= "file://update-ca-certificates-support-Toybox.patch"

# disable automatic start of swupdate.service
SYSTEMD_SERVICE:swupdate:remove:pn-swupdate= "swupdate.service"

# enforce identical busybox configuration for iot and iotedge; non-busybox tools lspci, lsusb, ps, nsenter are used
BBMASK:append = " ${@bb.utils.contains('DISTRO_FEATURES', 'iotedge', '/meta-virtualization/recipes-core/busybox/busybox_%.bbappend', '', d)}"
```

## conf/distro/include/ics-dm-os-preferred.conf
```bitbake
PREFERRED_PROVIDER_u-boot-default-script ?= "u-boot-scr"
PREFERRED_PROVIDER_u-boot-fw-utils ?= "libubootenv"
PREFERRED_PROVIDER_virtual/docker = "docker-moby"
PREFERRED_VERSION_cargo = "1.58.1"
PREFERRED_VERSION_rust = "1.58.1"
```

## conf/distro/include/ics-dm-os-rust.conf
```bitbake
# we need this to get bindgen-native to work at runtime
EXTRA_OECMAKE:append:pn-rust-llvm-native = " -DLLVM_ENABLE_PROJECTS=clang"

# set default rust panic strategy to abort, otherwise we have to patch iotedge
# warning: this is global setting
RUST_PANIC_STRATEGY = "abort"

# we need rust 1.62.x from meta-ics-dm
RUSTVERSION = "1.62%"

# enforce cargo offline builds
# - this setting is mainly for yocto branches < kirkstone
# - in kirkstone the network access is restricted in do_configure and
#   do_compile steps anyway
# warning: this is a global setting
CARGO_NET_OFFLINE = "true"
```

## conf/distro/include/ics-dm-os-swupdate.conf
```bitbake
SOFTWARE_VERSION = "${DISTRO_VERSION}"
SOFTWARE_NAME = "${DISTRO_NAME}"

# disable automatic start of swupdate.service
SYSTEMD_SERVICE:swupdate:remove:pn-swupdate= "swupdate.service"
```

## conf/distro/include/ics-dm-os-user_classes.conf
```bitbake
# The following USER_CLASSES:append calls delay setting certain features
# depending on DISTRO_FEATURES/MACHINE_FEATURES. At load time of config files
# the content of DISTRO_FEATURES resp. MACHINE_FEATURES are empty.
#
# If we install iotedge we have to add 'virtualization' to 'DISTRO_FEATURES'.
USER_CLASSES:append = " ${@bb.utils.contains('DISTRO_FEATURES', 'iotedge', 'append_virtualization', '', d)}"
#
# Optional tpm
USER_CLASSES:append = " ${@bb.utils.contains('MACHINE_FEATURES', 'tpm2', 'tpm-cfg', '', d)}"
#
# We need a nonvolatile log dir when DISTRO_FEATURE "persistent-var-log" is set.
USER_CLASSES:append = " ${@bb.utils.contains('DISTRO_FEATURES', 'persistent-var-log', 'disable_volatile_log_dir', '', d)}"
#
# We need to add remote-features-module when DISTRO_FEATURE "remote-features-module" is set.
USER_CLASSES:append = " ${@bb.utils.contains('DISTRO_FEATURES', 'remote-features-module', 'remote-features-module', '', d)}"
```

## conf/distro/include/omnect-os-bootloader-version.conf
```bitbake
# define magic number for embedded bootloader version
OMNECT_BOOTLOADER_EMBEDDED_VERSION_MAGIC = "19 69 02 28"
```

## conf/distro/include/omnect-os-cve.conf
```bitbake
CVE_PRODUCT:pn-onig ??=     "oniguruma"
OMNECT_CVE_VERSION_SPLIT:pn-sudo = "1"
OMNECT_CVE_VERSION_SPLIT:pn-openssh = "1"
```

## conf/distro/include/omnect-os-dev.conf
```bitbake
FILESEXTRAPATHS:prepend:pn-iptables := "${LAYERDIR_omnect}/files/dev:"

# let systemd-coredump log a backtrace (module+offset) to the journal
PACKAGECONFIG:append:pn-systemd = " elfutils"
```

## conf/distro/include/omnect-os-distro.conf
```bitbake
TARGET_VENDOR = "-omnect"
DISTRO = "omnect-os"
DISTRO_NAME = "${DISTRO_NAME_PREFIX}OMNECT${DISTRO_NAME_SUFFIX}"
DISTRO_VERSION = "${OE_VERSION}.${OMNECT_BUILD_NUMBER}"
SDK_NAME_PREFIX = "${DISTRO_NAME}"
SDK_VERSION = "${MACHINE}-${DISTRO_VERSION}"

DISTRO_FEATURES = "debuginfod ipv4 ipv6 polkit seccomp zeroconf"
DISTRO_FEATURES_BACKFILL_CONSIDERED += "pulseaudio gobject-introspection-data ldconfig"

#DISTRO_FEATURES depending on MACHINE_FEATURES:
DISTRO_FEATURES += "${@bb.utils.contains('MACHINE_FEATURES', '3g', '3g', '', d)}"
DISTRO_FEATURES += "${@bb.utils.contains('MACHINE_FEATURES', 'bluetooth', 'bluetooth', '', d)}"
DISTRO_FEATURES += "${@bb.utils.contains('MACHINE_FEATURES', 'wifi', 'wifi', '', d)}"

#override packagroup-base settings
RDEPENDS:packagegroup-base-3g:pn-packagegroup-base = ""

# We don't use qemu-usermode, resp. it is currently not usable straightforward.
MACHINE_FEATURES_BACKFILL_CONSIDERED += "qemu-usermode"
# Remove machine features we don't see any value in.
# -> packagegroup-base doesn't install unwanted packages
MACHINE_FEATURES:remove = "alsa ext2 pci pcmcia serial usbhost usbgadget vfat"

# Systemd
INIT_MANAGER ?= "systemd"
# disable sysusers
# Uids/gids created by systemd-sysusers could potentially clash with
# uids/gids introduced by later update images.
PACKAGECONFIG:remove:pn-systemd = "sysusers"
# enable (configuring) coredump handling
PACKAGECONFIG:append:pn-systemd = " coredump"

JOURNALD_SystemMaxUse ?= "128M"

# Use opkg's ipk
PACKAGE_CLASSES ?= "package_ipk"

# Check if Buildsystem can reach remote sources
CONNECTIVITY_CHECK_URIS ?= "https://github.com/omnect"

# Image configuration
IMAGE_FSTYPES = "ext4.gz wic.xz wic.bmap"
# rm kernel from boot partition, we use a bundled initramfs kernel in rootfs
IMAGE_BOOT_FILES:remove = "uImage Image"
# instead of kernel we want the initramfs bundled kernel
IMAGE_INSTALL:remove = "kernel"

# define partition (default) sizes in KiB
#     Note, the last data partition will be expanded during the first boot after image flashing inside the INITRAMFS.
#     This means, OMNECT_PART_SIZE_DATA is the initial value.
#     Note, machine configurations can override these values.
OMNECT_PART_SIZE_BOOT      ??= "40960"
OMNECT_PART_SIZE_UBOOT_ENV ??= "64"
OMNECT_PART_REDUNDANT_UBOOT_ENV ??= "1"
# given that each machine now defines its own value for OMNECT_PART_SIZE_ROOTFS
# now, a fixed value for a fallback doesn't make sense anymore
# OMNECT_PART_SIZE_ROOTFS    ??= "760832"
OMNECT_PART_SIZE_FACTORY   ??= "102400"
OMNECT_PART_SIZE_CERT      ??= "40960"
OMNECT_PART_SIZE_ETC       ??= "40960"
OMNECT_PART_SIZE_DATA      ??= "524288"

# setup OOM behaviour
OMNECT_VM_PANIC_ON_OOM ?= "0"

# enable variable expansion in wks includes
WICVARS:append = " OMNECT_PART_SIZE_BOOT"
WICVARS:append = " OMNECT_PART_SIZE_UBOOT_ENV"
WICVARS:append = " OMNECT_PART_SIZE_ROOTFS"
WICVARS:append = " OMNECT_PART_SIZE_FACTORY"
WICVARS:append = " OMNECT_PART_SIZE_CERT"
WICVARS:append = " OMNECT_PART_SIZE_ETC"
WICVARS:append = " OMNECT_PART_SIZE_DATA"
WICVARS:append = " OMNECT_PART_OFFSET_UBOOT_ENV1"
WICVARS:append = " OMNECT_PART_OFFSET_UBOOT_ENV2"
WICVARS:append = " OMNECT_PART_OFFSET_BOOT"

# on x86 poky sets these as default dependencies ... we don't use them
WKS_FILE_DEPENDS_BOOTLOADERS:remove = "syslinux systemd-boot"

# limit max rootfs size
IMAGE_ROOTFS_MAXSIZE = "${OMNECT_PART_SIZE_ROOTFS}"

# initramfs
OMNECT_INITRAMFS_IMAGE_NAME = "${DISTRO_NAME}_${DISTRO_VERSION}_${MACHINE}-initramfs"

# lower alternative default priority
ALTERNATIVE_PRIORITY_coreutils = "30"
ALTERNATIVE_PRIORITY_procps = "40"

# explicitly control utilities used
ALTERNATIVE_PRIORITY_coreutils[dd] = "100"
ALTERNATIVE_PRIORITY_coreutils[cp] = "100"
ALTERNATIVE_PRIORITY_procps[ps] = "100"

# enable sourcing /etc/bashrc so non-loginshells can use bash-completion
CFLAGS:append:pn-bash = " -DSYS_BASHRC='"/etc/bashrc"'"

# enable poweroff for busybox for flash-mode 2
# disable busybox syslog+klog when using systemd
FILESEXTRAPATHS:prepend:pn-busybox := "${LAYERDIR_omnect}/files:"
SRC_URI:remove:pn-busybox = "file://syslog.cfg"
SRC_URI:append:pn-busybox = " \
    file://busybox-enable-poweroff.cfg \
    ${@bb.utils.contains('DISTRO_FEATURES', 'systemd', ' file://busybox-systemd-disable-syslog-klog.cfg','', d)} \
"
SYSTEMD_SERVICE:remove:pn-busybox-syslog = "file://busybox-syslog.service"

# restrict bluez5 dependencies
# bluez 5.72 doesn't link without "a2dp-profiles avrcp-profiles"
PACKAGECONFIG:pn-bluez5 ?= "${@bb.utils.contains('OMNECT_RELEASE_IMAGE', '1', 'systemd udev a2dp-profiles avrcp-profiles', 'systemd udev a2dp-profiles avrcp-profiles deprecated readline tools', d)}"

# restrict docker-moby dependencies
PACKAGECONFIG:pn-docker-moby ?= "seccomp"

# restrict jq dependencies
PACKAGECONFIG:pn-jq = ""

# get rid of perl as runtime dependency in release image
PACKAGES:remove:pn-nss = "nss-smime"
PACKAGES:remove:pn-openssl = "openssl-misc"

# define default devel tools to be included in image
OMNECT_DEVEL_TOOLS = "\
    curl \
    e2fsprogs \
    ethtool \
    gdbserver \
    htop \
    i2c-tools \
    iproute2-ip \
    ldd \
    less \
    lshw \
    lsof \
    ltrace \
    mmc-utils \
    screen \
    strace \
    sysstat \
    tcpdump \
    valgrind \
    ${@bb.utils.contains('DISTRO_FEATURES', 'tpm2', 'tpm2-tools', '', d)} \
    ${@bb.utils.contains('MACHINE_FEATURES', 'efi', 'efibootmgr', '', d)} \
"

OMNECT_DEVEL_TOOLS:append:x86-64 = "acpica dmidecode"

# make target architecture visible for later processing, e.g., in os-release
# note: TARGET_ARCH must be expanded immediately to retrieve the correct value.
OMNECT_TARGET_ARCH := "${TARGET_ARCH}"
```

## conf/distro/include/omnect-os-fixes.conf
```bitbake
# docker: we don't use btrfs and support is disabled in docker-moby per default anyway
DEPENDS:remove:pn-docker-moby = "btrfs-tools"

# libx11: correct build dependency, otherwise 'autoconf-archive' lands in sbom
DEPENDS:remove:pn-libx11 = "autoconf-archive"
DEPENDS:append:pn-libx11 = " autoconf-archive-native"

# lshw: fix lshw e.g. on tauri-l
FILESEXTRAPATHS:prepend:pn-lshw := "${LAYERDIR_omnect}/files/patches:"
SRC_URI:append:pn-lshw = " file://lshw_github_PR87.patch"

# wrynose promoted the patch-status QA check to a fatal error. Our local recipe
# patches carry no Upstream-Status; silence the check (remove from both ERROR_QA and
# WARN_QA) rather than annotate every patch.
ERROR_QA:remove = "patch-status"
WARN_QA:remove = "patch-status"

# wrynose's oe-core also makes the buildpaths check fatal. Some Rust recipes (e.g. the
# aziot cc-crate openssl engine) leak a ${WORKDIR} path into -dbg debug info that
# escapes the debug-prefix-map remap; downgrade to a warning rather than chase the
# per-crate remap. The runtime (non-dbg) binaries are clean.
ERROR_QA:remove = "buildpaths"
WARN_QA:append = " buildpaths"

# wrynose's coreutils-dev RRECOMMENDS gawk-dev, but gawk is GPL-3.0-or-later &
# AGPL-3.0-or-later and excluded by INCOMPATIBLE_LICENSE. The skipped provider
# breaks the rootfs build-dependency graph, so drop the recommend in metadata
# (BAD_RECOMMENDATIONS only filters at install time, too late for taskdata).
RRECOMMENDS:coreutils-dev:remove = "gawk-dev"
```
