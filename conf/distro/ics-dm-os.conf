## conf/distro/include/omnect-os-kernel.conf
```bitbake
# - we enable overlayfs for all kernels (dependency of our partition layout)
# - we disable kvm (e.g. set by linux-phytec-imx)
OMNECT_KERNEL_SRC_URI_LTE = " \
    file://mbim.cfg \
    file://qualcomm.cfg \
    file://sierra.cfg \
"

OMNECT_KERNEL_SRC_URI = " \
    file://cpu_freq_default_gov_schedutil.cfg \
    file://enable-overlayfs.cfg \
    file://enable-cifs.cfg \
    file://enable-ext4-fs-security.cfg \
    file://disable-kvm.cfg \
    file://netfilter.cfg \
    file://usb-serial-devices.cfg \
    file://virtualization.cfg \
    file://wireguard.cfg \
    ${@bb.utils.contains('MACHINE_FEATURES', 'pstore', 'file://pstore.cfg', '', d)} \
    ${@bb.utils.contains('MACHINE_FEATURES', '3g', '${OMNECT_KERNEL_SRC_URI_LTE}', '', d)} \
    ${@bb.utils.contains('MACHINE_FEATURES', 'can', 'file://vcan_vxcan.cfg', '', d)} \
"

KERNEL_FEATURES:append = " \
    cfg/docker.scc \
    cfg/lxc.scc \
    cfg/kubernetes.scc \
"

# enforce identical kernel config independent of meta-virtualization
BBMASK:append = " meta-virtualization/recipes-kernel/linux/linux-%.bbappend"
FILESEXTRAPATHS:prepend:pn-linux-phytec-imx := "${LAYERDIR_omnect}/recipes-kernel/linux/files:"
FILESEXTRAPATHS:prepend:pn-linux-raspberrypi := "${LAYERDIR_omnect}/recipes-kernel/linux/files:${LAYERDIR_virtualization-layer}/recipes-kernel/linux/linux-yocto:"
FILESEXTRAPATHS:prepend:pn-linux-yocto := "${LAYERDIR_omnect}/recipes-kernel/linux/files:${LAYERDIR_virtualization-layer}/recipes-kernel/linux/linux-yocto:"

SRC_URI:append:pn-linux-phytec-imx = " ${OMNECT_KERNEL_SRC_URI}"
SRC_URI:append:pn-linux-raspberrypi = " ${OMNECT_KERNEL_SRC_URI}"
SRC_URI:append:pn-linux-yocto = " ${OMNECT_KERNEL_SRC_URI}"
```

## conf/distro/include/omnect-os-preferred.conf
```bitbake
PREFERRED_PROVIDER_u-boot-default-script ?= "u-boot-scr"
PREFERRED_PROVIDER_u-boot-fw-utils ?= "libubootenv"
PREFERRED_PROVIDER_util-linux-sfdisk-native ?= "util-linux-native"
PREFERRED_PROVIDER_virtual/docker = "docker-moby"
```

## conf/distro/include/omnect-os-release.conf
```bitbake
# use special release iptables config
FILESEXTRAPATHS:prepend:pn-iptables := "${LAYERDIR_omnect}/files/release:"

# disable getty on serial console
SERIAL_CONSOLES = ""

# https://docs.yoctoproject.org/4.0.6/singleindex.html#term-APPEND
# the manual says it is a grub-efi specific var, but it is also used in the
# syslinux.bbclass. so we use it in our case for u-boot.
#
# kernel log quiet on console except loglevel critical and above
#
# Note:
#   extra variable OMNECT_APPEND_1ST_BOOT is used here to ensure these special
#   settings to be even active on first boot after flashing where parameters
#   stored in file omnect_extra_bootargs_omnect can not yet take effect.
OMNECT_APPEND_1ST_BOOT += "quiet loglevel=3"
APPEND += "${OMNECT_APPEND_1ST_BOOT}"
# systemd.getty_auto=false -> https://www.freedesktop.org/software/systemd/man/systemd-getty-generator.html
APPEND += "systemd.getty_auto=false"
```

## conf/distro/include/omnect-os-rust.conf
```bitbake
# set default rust panic strategy to abort, otherwise we have to patch iotedge
# warning: this is global setting
RUST_PANIC_STRATEGY = "abort"
```

## conf/distro/include/omnect-os-tpm.conf
```bitbake
DISTRO_FEATURES:append = " tpm2"
MACHINE_FEATURES:append = " tpm2"

EXTRA_OECONF:append:pn-tpm2-tss = " --disable-weakcrypto --enable-debug=info"
```

## conf/distro/omnect-os.conf
```bitbake
include conf/machine/${MACHINE}.extra.conf
require conf/distro/include/omnect-os-distro.conf
require conf/distro/include/omnect-os-fixes.conf
require conf/distro/include/omnect-os-preferred.conf
require conf/distro/include/omnect-os-user_classes.conf
require conf/distro/include/omnect-os-kernel.conf
require conf/distro/include/omnect-os-rust.conf
require conf/distro/include/omnect-os-swupdate.conf
require conf/distro/include/omnect-os-cve.conf

OMNECT_RELEASE_IMAGE ?= "0"
require ${@bb.utils.contains('OMNECT_RELEASE_IMAGE', '1', 'conf/distro/include/omnect-os-release.conf', 'conf/distro/include/omnect-os-dev.conf', d)}
```

## conf/layer.conf
```bitbake
# We have a conf and classes directory, add to BBPATH
BBPATH .= ":${LAYERDIR}"

# We have recipes-* directories, add to BBFILES
BBFILES += "\
    ${LAYERDIR}/recipes-*/*/*.bb \
    ${LAYERDIR}/recipes-*/*/*.bbappend \
    ${LAYERDIR}/recipes-*/*/*/*.bb \
    ${LAYERDIR}/recipes-*/*/*/*.bbappend \
"

BBFILES_DYNAMIC += "\
    freescale-layer:${LAYERDIR}/dynamic-layers/freescale-layer/recipes-*/*/*.bb \
    freescale-layer:${LAYERDIR}/dynamic-layers/freescale-layer/recipes-*/*/*.bbappend \
    phytec:${LAYERDIR}/dynamic-layers/phytec/recipes-*/*/*.bb \
    phytec:${LAYERDIR}/dynamic-layers/phytec/recipes-*/*/*.bbappend \
    raspberrypi:${LAYERDIR}/dynamic-layers/raspberrypi/recipes-*/*/*.bb \
    raspberrypi:${LAYERDIR}/dynamic-layers/raspberrypi/recipes-*/*/*.bbappend \
    virtualization-layer:${LAYERDIR}/dynamic-layers/virtualization/recipes-*/*/*.bb \
    virtualization-layer:${LAYERDIR}/dynamic-layers/virtualization/recipes-*/*/*.bbappend \
    virtualization-layer:${LAYERDIR}/dynamic-layers/virtualization/recipes-*/*/*/*.bb \
    virtualization-layer:${LAYERDIR}/dynamic-layers/virtualization/recipes-*/*/*/*.bbappend \
    welotec-bsp-layer:${LAYERDIR}/dynamic-layers/welotec-bsp-layer/recipes-*/*/*.bb \
    welotec-bsp-layer:${LAYERDIR}/dynamic-layers/welotec-bsp-layer/recipes-*/*/*.bbappend \
"
BBFILE_COLLECTIONS += "omnect"
BBFILE_PATTERN_omnect = "^${LAYERDIR}/"
BBFILE_PRIORITY_omnect = "10"

LAYERDEPENDS_omnect = "swupdate"
LAYERSERIES_COMPAT_omnect = "scarthgap"
LAYERDIR_omnect = "${LAYERDIR}"

# orchestrate other layers (we ensure our layer is latest when building with kas)
# if you don't use kas, you should ensure meta-omnect is behind meta-phytec resp. meta-welotec-bsp in BBLAYERS.
BBFILE_PRIORITY_phytec = "9"
BBFILE_PRIORITY_raspberrypi="9"
BBFILE_PRIORITY_welotec-bsp-layer = "9"
```

## conf/machine/arrakis-pico.conf
```bitbake
require conf/machine/genericx86-64.conf

# additional kernel config
OMNECT_KERNEL_SRC_URI:append = " \
    file://crc32c-intel_module.cfg \
    file://disable_wlan.cfg \
    file://intel-lpc_ich_module.cfg \
    file://intel-mei_module.cfg \
    file://intel-vbtn_module.cfg \
    file://pc-speaker.cfg \
    file://tcg_tpm_2.0.cfg \
"
# default kernel parameter
APPEND = "console=tty0"
# module autoload
KERNEL_MODULE_AUTOLOAD = "mei"

# bootloader
PREFERRED_PROVIDER_virtual/bootloader = "grub-efi"
# don't create grub-efi in rootfs
EFI_PROVIDER = " "

# swupdate has a hard dependency to libubootenv (in swupdate_vars.(c|h)).
# so we can not get rid of it, but we can get rid of a uboot boot script.
DEPENDS:remove:pn-libubootenv = "u-boot-default-script"

# initramfs type
OMNECT_INITRAMFS_FSTYPE = "cpio.gz"

# image generation
WKS_FILE = "omnect-os.grub.wks.in"
# no differentiation for now between release an devel images concerning rootfs
# size
OMNECT_PART_SIZE_ROOTFS ?= "${@bb.utils.contains('OMNECT_RELEASE_IMAGE', '1', '819200', '819200', d)}"
# where to find initial grubenv
WICVARS:append = " OMNECT_GRUBENV_FILE"
OMNECT_GRUBENV_FILE = "${LAYERDIR_omnect}/files/grubenv"
OMNECT_ROOT_DEVICE = "/dev/nvme0n1"

# adu compatibility id
ADU_DEVICEPROPERTIES_COMPATIBILITY_ID = "1"

# machine
MACHINE_FEATURES = " \
    3g \
    acpi \
    efi \
    grub \
    keyboard \
    pcbios \
    pci \
    screen \
    serial \
    tpm2 \
    usbhost \
    x86 \
"
MACHINEOVERRIDES = "omnect_grub:genericx86-64"
MACHINE_EXTRA_RRECOMMENDS += "linux-firmware-i915"
# don't install every available firmware
MACHINE_EXTRA_RRECOMMENDS:remove = "linux-firmware"

# if an LTE modem is present it is a Quectel EC25
OMNECT_WAIT_ONLINE_INTERFACES_BUILD =  "enp1s0:enp2s0:enp3s0:wwp0s21f0u8i4"

# configure hardware watchdog
# the maximum watchdog deadline depends on the hardware capabilities
SYSTEMD_RuntimeWatchdogSec  = "60"
SYSTEMD_RebootWatchdogSec   = "60"
```

## conf/machine/eg500.extra.conf
```bitbake
PREFERRED_PROVIDER_virtual/kernel = "linux-welotec"
PREFERRED_PROVIDER_virtual/bootloader = "grub-efi"

# initramfs type
OMNECT_INITRAMFS_FSTYPE = "cpio.gz"

# wic: how to partition
WKS_FILE = "omnect-os.eg500.wks.in"

# where to find initial grubenv
WICVARS:append = " OMNECT_GRUBENV_FILE"
OMNECT_GRUBENV_FILE = "${LAYERDIR_omnect}/files/grubenv"

# configuration for grub.cfg
OMNECT_ROOT_DEVICE = "/dev/nvme0n1"

# don't create grub-efi in rootfs
EFI_PROVIDER = " "

# adu compatibility id
ADU_DEVICEPROPERTIES_COMPATIBILITY_ID = "2"

# unset welotec's defaults
INITRAMFS_IMAGE = ""
INITRAMFS_IMAGE_BUNDLE = ""
INITRAMFS_MAXSIZE = ""

# we use libubootenv but not u-boot for this device
DEPENDS:remove:pn-libubootenv = "u-boot-default-script"

# if an LTE modem is present it is a Quectel EC25
OMNECT_WAIT_ONLINE_INTERFACES_BUILD =  "enp1s0:enp2s0:enp3s0:wwp0s21f0u8i4"

# remove distro features we don't support
DISTRO_FEATURES:remove = " \
    alsa \
    bluetooth \
    nfc \
    opengl \
    pulseaudio \
    x11 \
    vulkan \
    wayland \
    wifi \
"

# this machine uses grub
MACHINEOVERRIDES:append = ":omnect_grub"

MACHINE_FEATURES += "tpm2 3g"
MACHINE_EXTRA_RRECOMMENDS += "linux-firmware-i915"

# don't install every available firmware
MACHINE_EXTRA_RRECOMMENDS:remove = "linux-firmware"

# @todo remove me when solved where eee-acpi-scripts is located
MACHINE_EXTRA_RRECOMMENDS:remove = "eee-acpi-scripts"

# no differentiation for now between release an devel images concerning rootfs
# size
OMNECT_PART_SIZE_ROOTFS ?= "${@bb.utils.contains('OMNECT_RELEASE_IMAGE', '1', '819200', '819200', d)}"
```

## conf/machine/genericx86-64.extra.conf
```bitbake
# additional kernel config
OMNECT_KERNEL_SRC_URI:append = " \
    file://acpi-watchdog.cfg \
    file://crc32c-intel_module.cfg \
    file://bluetooth_hcibtusb.cfg \
    file://i2c-chardev.cfg \
    file://intel-igc.cfg \
    file://intel-lpc_ich_module.cfg \
    file://intel-mei_module.cfg \
    file://intel-vbtn_module.cfg \
    file://pc-speaker.cfg \
    file://tcg_tpm_2.0.cfg \
    file://wifi_ath10k_pci.cfg \
"

# default kernel parameter
APPEND = "console=tty0"

# below are the extra kernel command line args for reboot reason support
APPEND:append:omnect_pstore = " pstore.backend=efi printk.always_kmsg_dump=Y crash_kexec_post_notifiers=Y"

# module autoload
KERNEL_MODULE_AUTOLOAD = "mei"

# bootloader
PREFERRED_PROVIDER_virtual/bootloader = "grub-efi"
# don't create grub-efi in rootfs
EFI_PROVIDER = " "

# swupdate has a hard dependency to libubootenv (in swupdate_vars.(c|h)).
# so we can not get rid of it, but we can get rid of a uboot boot script.
DEPENDS:remove:pn-libubootenv = "u-boot-default-script"

# initramfs type
OMNECT_INITRAMFS_FSTYPE = "cpio.gz"

# image generation
WKS_FILE = "omnect-os.grub.wks.in"
# no differentiation for now between release an devel images concerning rootfs
# size
OMNECT_PART_SIZE_ROOTFS ?= "${@bb.utils.contains('OMNECT_RELEASE_IMAGE', '1', '900000', '900000', d)}"
OMNECT_PART_OFFSET_BOOT ?= "2048"

# adu compatibility id
OMNECT_ADU_DEVICEPROPERTIES_COMPATIBILITY_ID = "0"

# machine
MACHINE_FEATURES = " \
    3g \
    acpi \
    bluetooth \
    efi \
    grub \
    keyboard \
    pcbios \
    pci \
    screen \
    serial \
    tpm2 \
    usbhost \
    wifi \
    x86 \
"
# once arrakis device is capable of supporting it, add pstore to
# MACHINE_FEATURES above and enable override below
# MACHINEOVERRIDES:prepend = "omnect_pstore:"
MACHINEOVERRIDES:prepend = "omnect_grub:"
MACHINE_EXTRA_RRECOMMENDS += "linux-firmware-i915 linux-firmware-ath10k linux-firmware-qca"
# don't install every available firmware
MACHINE_EXTRA_RRECOMMENDS:remove = "linux-firmware"

DISTRO_FEATURES:append = " efi-secure-boot modsign"

# for patched wic plugin bootimg-efi.py:
WICVARS:append = " OMNECT_GRUB_EFI_SB_FILES"
OMNECT_GRUB_EFI_SB_FILES = " \
    boot-menu.inc \
    boot-menu.inc.p7b \
    efi-secure-boot.inc \
    efi-secure-boot.inc.p7b \
    grub.cfg \
    grub.cfg.p7b \
    grubenv \
    omnect_bootloader_version \
    bootx64.efi \
    grubx64.efi \
    LockDown.efi \
    mmx64.efi \
    SELoaderx64.efi \
"

# configure hardware watchdog
# the maximum watchdog deadline depends on the hardware capabilities
SYSTEMD_RuntimeWatchdogSec  = "60"
SYSTEMD_RebootWatchdogSec   = "60"

OMNECT_BOOTLOADER_RECIPE_PATH = "${LAYERDIR_core}/recipes-bsp/grub/grub-efi_2.12.bb"
# force bootloader version checksum to be old, when sure it's 100% binary compatible
# OMNECT_BOOTLOADER_CHECKSUM_COMPATIBLE:pn-bootloader-versioned = "<newchecksum> <oldchecksum>"
# e.g.:
# OMNECT_BOOTLOADER_CHECKSUM_COMPATIBLE:pn-bootloader-versioned = "2cf3dd5f692d9ed563f06ecf80d0cb566ddc165fa01a37b4eba663dc7b7b9087 ebe0e595a3efb112b7495a14f9562d89d00041390f26a9ad4985435687bf2311"
#
# OMNECT_BOOTLOADER_CHECKSUM_EXPTECTED:pn-bootloader-versioned - build will fail, if the
# computed checksum is different to this; set to <oldchecksum> when
# OMNECT_BOOTLOADER_CHECKSUM_COMPATIBLE:pn-bootloader-versioned is set
OMNECT_BOOTLOADER_CHECKSUM_EXPECTED:pn-bootloader-versioned = "7313453d081e9c6e2994a7e7c8943a677dcd5719af07aa4ac6e5f20bb1702ef2"
#OMNECT_BOOTLOADER_CHECKSUM_COMPATIBLE:pn-bootloader-versioned = ""
```
